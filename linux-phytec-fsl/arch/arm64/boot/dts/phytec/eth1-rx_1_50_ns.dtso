/*
 * SPDX-License-Identifier: GPL-2.0
 * Copyright (C) 2020 PHYTEC America, LLC - https://www.phytec.com
 *
 */
#include <dt-bindings/net/ti-dp83867.h>

/dts-v1/;
/plugin/;

/ {
	compatible = "phytec,imx8qxp-pcm-942", "phytec,imx8qxp-phycore-som", "fsl,imx8qxp";

	fragment@0 {

		target = <&mdio>;
		__overlay__ {
			ethphy1: ethernet-phy@3 {
				compatible = "ethernet-phy-ieee802.3-c22";
				reg = <3>;
				ti,rx-internal-delay = <DP83867_RGMIIDCTL_1_50_NS>;
				ti,fifo-depth = <DP83867_PHYCR_FIFO_DEPTH_8_B_NIB>;
				ti,led-0-active-low;
				ti,led-2-active-low;
				enet-phy-lane-no-swap;
			};
		};
	};
};
